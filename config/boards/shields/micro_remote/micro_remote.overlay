/ {
    chosen {
        zmk,kscan = &kscan0;
    };

    kscan0: kscan_0 {
        compatible = "zmk,kscan-gpio-direct";
        wakeup-source;
        
        input-gpios
            = <&gpio0 22 (GPIO_ACTIVE_LOW | GPIO_PULL_UP)> // 0: D-pad 상
            , <&gpio0 20 (GPIO_ACTIVE_LOW | GPIO_PULL_UP)> // 1: D-pad 우
            , <&gpio1 15 (GPIO_ACTIVE_LOW | GPIO_PULL_UP)> // 2: D-pad 하
            , <&gpio0 29 (GPIO_ACTIVE_LOW | GPIO_PULL_UP)> // 3: D-pad 좌
            , <&gpio0 2  (GPIO_ACTIVE_LOW | GPIO_PULL_UP)> // 4: 스틱누름
            , <&gpio1 4  (GPIO_ACTIVE_LOW | GPIO_PULL_UP)> // 5: 숫자 1
            , <&gpio1 0  (GPIO_ACTIVE_LOW | GPIO_PULL_UP)> // 6: 숫자 2
            , <&gpio1 6  (GPIO_ACTIVE_LOW | GPIO_PULL_UP)> // 7: 숫자 3
            , <&gpio0 11 (GPIO_ACTIVE_LOW | GPIO_PULL_UP)> // 8: 숫자 4
            , <&gpio0 9  (GPIO_ACTIVE_LOW | GPIO_PULL_UP)> // 9: 숫자 5
            , <&gpio1 13 (GPIO_ACTIVE_LOW | GPIO_PULL_UP)> // 10: 숫자 6
            , <&gpio0 10 (GPIO_ACTIVE_LOW | GPIO_PULL_UP)> // 11: 숫자 7
            , <&gpio1 11 (GPIO_ACTIVE_LOW | GPIO_PULL_UP)> // 12: 숫자 8
            , <&gpio0 17 (GPIO_ACTIVE_LOW | GPIO_PULL_UP)> // 13: 문자 a
            , <&gpio1 7  (GPIO_ACTIVE_LOW | GPIO_PULL_UP)> // 14: 문자 b
            , <&gpio1 2  (GPIO_ACTIVE_LOW | GPIO_PULL_UP)> // 15: 문자 c
            , <&gpio1 1  (GPIO_ACTIVE_LOW | GPIO_PULL_UP)> // 16: 문자 d
            , <&gpio0 24 (GPIO_ACTIVE_LOW | GPIO_PULL_UP)>; // 17: 문자 e
    };
};
